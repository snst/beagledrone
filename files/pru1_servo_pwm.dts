/dts-v1/;
/plugin/;

/ {
    compatible = "ti,beaglebone", "ti,beaglebone-black";

    /* identification */
    part-number = "pru0_outputs";

    fragment@0 {
        target = <&am33xx_pinmux>;
        __overlay__ {
            pru0_output_pins: pru0_output_pins {
                pinctrl-single,pins = <
					0x0e0 0x05  
                    0x0e8 0x05  
					0x0e4 0x05  
					0x0ec 0x05  
                    0x0b8 0x05  
					0x0bc 0x05  
                    0x0b0 0x05  
					0x0b4 0x05  
                >;
            };
        };
    };

    fragment@1 {
        target = <&pruss>;
        __overlay__ {
			status = "okay";
			pinctrl-names = "default";
			pinctrl-0 = <&pru0_output_pins>;
		};
	};
};
